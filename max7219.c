#include "max7219.h"
#include "STC89C5xRC.H"

sbit clk = P2^0;
sbit cs = P2^1;
sbit din = P2^2;

unsigned char leftShiftStartPoint = 8;//移动开始位[0,16]
unsigned char leftShiftCurrentPoint = 8;//移动当前位
unsigned char leftShiftEndPoint = 16;//移动结束位的下一位[2,17]
unsigned char leftCode = 0;

unsigned char code dispCode[38][8]={
{0x3C,0x42,0x46,0x4A,0x52,0x62,0x42,0x3C},//0
{0x08,0x18,0x08,0x08,0x08,0x08,0x08,0x1C},//1
{0x3C,0x42,0x02,0x04,0x08,0x10,0x20,0x7E},//2
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{0xFE,0xBA,0x92,0xBA,0x92,0x9A,0xBA,0xFE},//国
};

//
void spiWrite(Max7219_addr_code addr, unsigned char dat)
{
	unsigned char i = 0;
	cs = 1;
	clk = 0;
	cs = 0;
	for(; i < 8; i++)
	{
		din = addr & 0x80;
		clk = 1;
		clk = 0;
		addr <<= 1;
	}
	for(i = 0; i < 8; i++)
	{
		din = dat & 0x80;
		clk = 1;
		clk = 0;
		dat <<= 1;
	}
	cs = 1;
}

void max7219Disp(unsigned char * buf)
{
	unsigned char i = 0;
	for(; i<8; i++)
	{
		spiWrite((Max7219_Digit_0 + i), buf[i]);
	}
}

void max7219Left(unsigned char * buf1, unsigned char * buf2)
{
	unsigned char i = 0;
	unsigned char tempBuf[8];
	if(leftShiftCurrentPoint <= 8)
	{
		for(i = 0; i < 8; i++)
		{
			tempBuf[i] = buf1[i]>>(8 - leftShiftCurrentPoint);
		}
	}
	else
	{
		for(i = 0; i < 8; i++)
		{
			tempBuf[i] = buf1[i]<<(leftShiftCurrentPoint - 8);
			tempBuf[i] |= buf2[i]>>(16 - leftShiftCurrentPoint);
		}
	}

	leftShiftCurrentPoint++;
	if(leftShiftCurrentPoint == leftShiftEndPoint)
	{
		leftShiftCurrentPoint = leftShiftStartPoint;
		if(++leftCode == 10)
		{
			leftCode = 0;
		}
	}
	max7219Disp(tempBuf);
}

void max7219Init()
{
	//设置扫描位
	spiWrite(Max7219_Scan_Limit, 0x57);//8wei
	//设置亮度
	spiWrite(Max7219_Intensity, 0x50);//0x50->0x5F 暗->亮
	//设置译码模式
	spiWrite(Max7219_Decode_Mode, 0x00);//不译码
	//设置初始显示内容
	max7219Disp(dispCode[0]);
	//打开显示
	spiWrite(Max7219_Shutdown, 0x01);//0x00为关闭
}